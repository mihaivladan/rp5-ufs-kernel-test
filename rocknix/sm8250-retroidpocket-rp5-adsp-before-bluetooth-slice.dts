// SPDX-License-Identifier: BSD-3-Clause
/* Exact Phase 6W/6Y slice plus the kernel-enforced ADSP dependency. */

#include "sm8250-retroidpocket-rp5-bluetooth-slice.dts"

&adsp {
	firmware-name = "adsp.mdt";
};

&{/soc@0/geniqup@9c0000/serial@998000/bluetooth} {
	qcom,rproc = <&adsp>;
};
